## meta-facebook/gt-cc/boards/ast1030_evb.conf
```kconfig
CONFIG_GPIO_ASPEED=y
CONFIG_SPI_ASPEED=y
CONFIG_I2C_ASPEED=y
CONFIG_ADC_ASPEED=y
CONFIG_JTAG_ASPEED=y
CONFIG_USB_ASPEED=y
CONFIG_WDT_ASPEED=y
CONFIG_I3C=y
CONFIG_I3C_ASPEED=y
CONFIG_I3C_SLAVE=y
CONFIG_I3C_SLAVE_MQUEUE=y
CONFIG_I3C_ASPEED_MAX_IBI_PAYLOAD=256

CONFIG_SYSTEM_WORKQUEUE_STACK_SIZE=2048
```
